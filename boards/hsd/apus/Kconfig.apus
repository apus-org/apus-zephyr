## boards/hsd/apus/Kconfig.apus
```kconfig
# Copyright (c) 2026 Jakob Jungreuthmayer
# SPDX-License-Identifier: Apache-2.0

config BOARD_APUS
	select SOC_STM32F072XB
```

## boards/hsd/apus/Kconfig.defconfig
```kconfig
# Copyright (c) 2026 Jakob Jungreuthmayer
# SPDX-License-Identifier: Apache-2.0

if BOARD_APUS

config SPI_STM32_INTERRUPT
	default y
	depends on SPI

endif # BOARD_APUS
```

## boards/hsd/apus/board.yml
```yaml
board:
  name: apus
  full_name: APUS
  vendor: hsd
  socs:
    - name: stm32f072xb
```

## west.yml
```yaml
# Copyright (c) 2026 Jakob Jungreuthmayer
# SPDX-License-Identifier: Apache-2.0

manifest:
  self:
    path: apus-zephyr

  remotes:
    - name: zephyrproject-rtos
      url-base: https://github.com/zephyrproject-rtos

  projects:
    - name: zephyr
      remote: zephyrproject-rtos
      revision: main
      import:
        name-allowlist:
          - cmsis_6
          - hal_stm32
```
